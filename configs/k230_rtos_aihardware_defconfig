## configs/k230_rtos_aihardware_defconfig
```kconfig
CONFIG_BOARD_K230_AIHARDWARE=y
CONFIG_BOARD_CONFIG_NAME="k230_rtos_aihardware_defconfig"
# CONFIG_RT_AUTO_RESIZE_PARTITION is not set
CONFIG_MPP_ENABLE_CSI_DEV_0=y
CONFIG_MPP_CSI_DEV0_RESET=23
CONFIG_MPP_CSI_DEV0_I2C_DEV="i2c0"
CONFIG_MPP_ENABLE_CSI_DEV_1=y
CONFIG_MPP_CSI_DEV1_RESET=0
CONFIG_MPP_CSI_DEV1_I2C_DEV="i2c3"
CONFIG_MPP_ENABLE_CSI_DEV_2=y
CONFIG_MPP_CSI_DEV2_RESET=24
CONFIG_MPP_CSI_DEV2_I2C_DEV="i2c1"
CONFIG_MPP_ENABLE_SENSOR_XS9950=y
CONFIG_MPP_ENABLE_DSI_HDMI=y
CONFIG_MPP_DSI_HDMI_RESET_PIN=42
CONFIG_MPP_DSI_HDMI_I2C_DEV="i2c4"
CONFIG_MPP_DSI_ENABLE_HDMI_LT9611=y
```

## configs/k230_rtos_evb_defconfig
```kconfig
CONFIG_BOARD_CONFIG_NAME="k230_rtos_evb_defconfig"
CONFIG_BOARD_K230_EVB=y
CONFIG_AUTO_DETECT_DDR_SIZE=y
# CONFIG_AUTO_DDR_SIZE_1024 is not set
# CONFIG_AUTO_DDR_SIZE_2048 is not set
CONFIG_RTT_AUTO_EXEC_CMD="/sdcard/app/examples/integrated_poc/smart_ipc.elf -K /sdcard/app/examples/integrated_poc/face_detection_320.kmodel -C 2"
CONFIG_RTT_ENABLE_BUILD_EXAMPLES=y
CONFIG_RTT_ENABLE_BUILD_INTEGRATED_EXAMPLES=y
CONFIG_MPP_ENABLE_CSI_DEV_0=y
CONFIG_MPP_CSI_DEV0_RESET=46
CONFIG_MPP_ENABLE_SENSOR_IMX335=y
CONFIG_MPP_SENSOR_IMX335_ENABLE_4LANE_CONFIGURE=y
CONFIG_MPP_ENABLE_DSI_LCD=y
CONFIG_MPP_DSI_LCD_RESET_PIN=9
CONFIG_MPP_DSI_LCD_BACKLIGHT_PIN=31
# CONFIG_MPP_DSI_ENABLE_VIRT is not set
CONFIG_MPP_DSI_ENABLE_LCD_HX8399=y
```

## configs/k230d_canmv_atk_dnk230d_defconfig
```kconfig
CONFIG_BOARD_K230D_CANMV_ATK_DNK230D=y
CONFIG_MPP_ENABLE_CSI_DEV_1=y
CONFIG_MPP_CSI_DEV1_RESET=10
CONFIG_MPP_CSI_DEV1_I2C_DEV="i2c4"
CONFIG_MPP_CSI_DEV1_MCLK_1=y
CONFIG_MPP_ENABLE_CSI_DEV_2=y
CONFIG_MPP_CSI_DEV2_RESET=4
CONFIG_MPP_CSI_DEV2_MCLK_2=y
CONFIG_MPP_ENABLE_SENSOR_GC2093=y
CONFIG_MPP_SENSOR_GC2093_ON_CSI1_USE_CHIP_CLK=y
CONFIG_MPP_SENSOR_GC2093_ON_CSI2_USE_CHIP_CLK=y
CONFIG_MPP_ENABLE_DSI_LCD=y
CONFIG_MPP_DSI_LCD_RESET_PIN=3
CONFIG_MPP_DSI_LCD_BACKLIGHT_PIN=5
CONFIG_MPP_DSI_ENABLE_LCD_ST7701=y
CONFIG_SDK_ENABLE_CANMV=y
# CONFIG_ENABLE_NETWORK_RT_WLAN is not set
CONFIG_MPP_DEFAULT_SENSOR_CSI_2=y
```

## configs/k230d_canmv_bpi_zero_defconfig
```kconfig
CONFIG_BOARD_K230D_CANMV_BPI_ZERO=y
CONFIG_MPP_ENABLE_CSI_DEV_0=y
CONFIG_MPP_CSI_DEV0_RESET=63
CONFIG_MPP_ENABLE_CSI_DEV_2=y
CONFIG_MPP_CSI_DEV2_RESET=62
CONFIG_MPP_CSI_DEV2_I2C_DEV="i2c4"
CONFIG_MPP_ENABLE_SENSOR_GC2093=y
CONFIG_MPP_ENABLE_SENSOR_OV5647=y
CONFIG_MPP_ENABLE_SENSOR_IMX335=y
CONFIG_MPP_SENSOR_IMX335_ON_CSI0_USE_CHIP_CLK=y
CONFIG_MPP_ENABLE_DSI_LCD=y
CONFIG_MPP_DSI_LCD_RESET_PIN=37
CONFIG_MPP_DSI_LCD_BACKLIGHT_PIN=-1
CONFIG_SDK_ENABLE_CANMV=y
```

## configs/k230d_labplus_ai_camera_defconfig
```kconfig
CONFIG_BOARD_K230D_CANMV_LABPLUS_AI_CAMERA=y
CONFIG_MPP_ENABLE_CSI_DEV_2=y
CONFIG_MPP_CSI_DEV2_RESET=62
CONFIG_MPP_CSI_DEV2_I2C_DEV="i2c0"
CONFIG_MPP_CSI_DEV2_MCLK_1=y
CONFIG_MPP_ENABLE_SENSOR_GC2093=y
CONFIG_MPP_SENSOR_GC2093_ON_CSI2_USE_CHIP_CLK=y
CONFIG_MPP_ENABLE_SENSOR_OV5647=y
CONFIG_MPP_SENSOR_OV5647_ON_CSI2_USE_CHIP_CLK=y
CONFIG_MPP_ENABLE_SENSOR_BF3238=y
CONFIG_MPP_ENABLE_SENSOR_BF3238_ON_CSI2_USE_CHIP_CLK=y
CONFIG_MPP_ENABLE_DSI_LCD=y
CONFIG_MPP_DSI_LCD_RESET_PIN=37
CONFIG_MPP_DSI_LCD_BACKLIGHT_PIN=36
CONFIG_MPP_DSI_ENABLE_LCD_ST7701=y
CONFIG_SDK_ENABLE_CANMV=y
# CONFIG_ENABLE_NETWORK_RT_LAN is not set
# CONFIG_ENABLE_NETWORK_RT_WLAN is not set
# CONFIG_ENABLE_TOUCH_DRIVER_CST_MUTCAP is not set
# CONFIG_ENABLE_TOUCH_DRIVER_GT911 is not set
CONFIG_MPP_DEFAULT_SENSOR_CSI_2=y
```

## src/applications/Kconfig
```kconfig
menu "Applications Configuration"

    source "$(SDK_BUILD_DIR)/Kconfig.app"

endmenu
```

## src/applications/helloworld/Kconfig
```kconfig
config APP_ENABLE_HELLOWORLD
    bool "Enable Applications HelloWorld"
    default n
```

## src/opensbi/Kconfig
```kconfig
menu "Opensbi Configuration"

    config OPENSBI_CONSOLE_UART_REG_ADDR
        hex
        default 0x91400000 if RTT_CONSOLE_UART0
        default 0x91401000 if RTT_CONSOLE_UART1
        default 0x91402000 if RTT_CONSOLE_UART2
        default 0x91403000 if RTT_CONSOLE_UART3
        default 0x91404000 if RTT_CONSOLE_UART4

endmenu
```

## src/rtsmart/Kconfig
```kconfig
menu "RT-Smart Configuration"

    choice RTT_CONSOLE_ID
        bool "Rtsmart console uart"
        default RTT_CONSOLE_UART0

        config RTT_CONSOLE_UART0
            bool "UART0"
        config RTT_CONSOLE_UART1
            bool "UART1"
        config RTT_CONSOLE_UART2
            bool "UART2"
        config RTT_CONSOLE_UART3
            bool "UART3"
        config RTT_CONSOLE_UART4
            bool "UART4"
    endchoice

    config RTT_CONSOLE_ID
        int
        default 0 if RTT_CONSOLE_UART0
        default 1 if RTT_CONSOLE_UART1
        default 2 if RTT_CONSOLE_UART2
        default 3 if RTT_CONSOLE_UART3
        default 4 if RTT_CONSOLE_UART4

    config RTT_CONSOLE_BAUD
        int "Rtsmart console uart baudrate"
        default 115200

    menuconfig RT_AUTO_RESIZE_PARTITION
        bool "Enable auto resize partition"
        default y
        help
            Support auto resize the last partition, use the disk remain space
            Now just support MMC device and MBR partition table.

        if RT_AUTO_RESIZE_PARTITION
            config RT_AUTO_RESIZE_PARTITION_NR
                int "Resize partition id"
                default 2

        endif

    config RTSMART_CONFIG_FILE
        string "Rtsmart config file prefix"
        default BOARD
        help
            rtsmart board config file name without _defconfig

    config RTT_AUTO_EXEC_CMD
        string "Rtsmart auto execute command string"
        default "/sdcard/micropython"

    comment "Examples Configuration"
    source "$(SDK_BUILD_DIR)/Kconfig.rtt_examples"

    comment "MPP Configuration"
    source "$(SDK_RTSMART_SRC_DIR)/mpp/Kconfig"

endmenu
```

## src/rtsmart/Kconfig.examples
```kconfig
menuconfig RTT_ENABLE_BUILD_EXAMPLES
    bool "Enable build Rtsmart examples"
    default n

    if RTT_ENABLE_BUILD_EXAMPLES

        menuconfig RTT_ENABLE_BUILD_AI_EXAMPLES
            bool "Enable build ai examples"
            default n
        
        choice RTT_AI_EXAMPLES_MODE
            bool "Display mode"
            default RTT_AI_EXAMPLES_MODE_HDMI
            depends on RTT_ENABLE_BUILD_AI_EXAMPLES && BOARD_K230_CANMV_01STUDIO

            config RTT_AI_EXAMPLES_MODE_HDMI
                bool "HDMI"
            config RTT_AI_EXAMPLES_MODE_LCD
                bool "LCD"
        endchoice

        if RTT_ENABLE_BUILD_AI_EXAMPLES

            config RTT_AI_EXAMPLES_ANOMALY_DET
                bool "Anomaly det Example"
                default y

            config RTT_AI_EXAMPLES_BYTETRACK
                bool "Bytetrack Example"
                default y

            config RTT_AI_EXAMPLES_CROSSWALK_DETECT
                bool "Crosswalk detect Example"
                default y

            config RTT_AI_EXAMPLES_DEC_AI_ENC
                bool "Dec ai enc Example"
                default y

            config RTT_AI_EXAMPLES_DEMO_MIX
                bool "Demo mix Example"
                default y

            config RTT_AI_EXAMPLES_DISTRACTION_REMINDER
                bool "Distraction reminder Example"
                default y

            config RTT_AI_EXAMPLES_DMS_SYSTEM
                bool "Dms system Example"
                default y

            config RTT_AI_EXAMPLES_DYNAMIC_GESTURE
                bool "Dynamic gesture Example"
                default y

            config RTT_AI_EXAMPLES_EYE_GAZE
                bool "Eye gaze Example"
                default y

            config RTT_AI_EXAMPLES_FACE_ALIGNMENT
                bool "Face alignment Example"
                default y

            config RTT_AI_EXAMPLES_FACE_DETECTION
                bool "Face detection Example"
                default y

            config RTT_AI_EXAMPLES_FACE_EMOTION
                bool "Face emotion Example"
                default y

            config RTT_AI_EXAMPLES_FACE_GENDER
                bool "Face gender Example"
                default y

            config RTT_AI_EXAMPLES_FACE_GLASSES
                bool "Face glasses Example"
                default y

            config RTT_AI_EXAMPLES_FACE_LANDMARK
                bool "Face landmark Example"
                default y

            config RTT_AI_EXAMPLES_FACE_MASK
                bool "Face mask Example"
                default y

            config RTT_AI_EXAMPLES_FACE_MESH
                bool "Face mesh Example"
                default y

            config RTT_AI_EXAMPLES_FACE_PARSE
                bool "Face parse Example"
                default y

            config RTT_AI_EXAMPLES_FACE_POSE
                bool "Face pose Example"
                default y

            config RTT_AI_EXAMPLES_FACE_VERIFICATION
                bool "Face verification Example"
                default y

            config RTT_AI_EXAMPLES_FALLDOWN_DETECT
                bool "Falldown detect Example"
                default y

            config RTT_AI_EXAMPLES_FINGER_GUESSING
                bool "Finger guessing Example"
                default y

            config RTT_AI_EXAMPLES_FITNESS
                bool "Fitness Example"
                default y

            config RTT_AI_EXAMPLES_HEAD_DETECTION
                bool "Head detection Example"
                default y

            config RTT_AI_EXAMPLES_HELMET_DETECT
                bool "Helmet detect Example"
                default y

            config RTT_AI_EXAMPLES_KWS
                bool "Kws Example"
                default y

            config RTT_AI_EXAMPLES_LICENCE_DET
                bool "Licence det Example"
                default y

            config RTT_AI_EXAMPLES_LICENCE_DET_REC
                bool "Licence det rec Example"
                default y

            config RTT_AI_EXAMPLES_NANOTRACKER
                bool "Nanotracker Example"
                default y

            config RTT_AI_EXAMPLES_OBJECT_DETECT_YOLOV8N
                bool "Object detect yolov8n Example"
                default y

            config RTT_AI_EXAMPLES_OCR
                bool "Ocr Example"
                default y

            config RTT_AI_EXAMPLES_PERSON_ATTR
                bool "Person attr Example"
                default y

            config RTT_AI_EXAMPLES_PERSON_DETECT
                bool "Person detect Example"
                default y

            config RTT_AI_EXAMPLES_PERSON_DISTANCE
                bool "Person distance Example"
                default y

            config RTT_AI_EXAMPLES_POSE_DETECT
                bool "Pose detect Example"
                default y

            config RTT_AI_EXAMPLES_PPHUMANSEG
                bool "Pphumanseg Example"
                default y

            config RTT_AI_EXAMPLES_PUZZLE_GAME
                bool "Puzzle game Example"
                default y

            config RTT_AI_EXAMPLES_SEGMENT_YOLOV8N
                bool "Segment yolov8n Example"
                default y

            config RTT_AI_EXAMPLES_SELF_LEARNING
                bool "Self learning Example"
                default y

            config RTT_AI_EXAMPLES_SMOKE_DETECT
                bool "Smoke detect Example"
                default y

            config RTT_AI_EXAMPLES_SPACE_RESIZE
                bool "Space resize Example"
                default y

            config RTT_AI_EXAMPLES_SQ_HAND_DET
                bool "Sq hand det Example"
                default y

            config RTT_AI_EXAMPLES_SQ_HANDKP_CLASS
                bool "Sq handkp class Example"
                default y

            config RTT_AI_EXAMPLES_SQ_HANDKP_DET
                bool "Sq handkp det Example"
                default y

            config RTT_AI_EXAMPLES_SQ_HANDKP_FLOWER
                bool "Sq handkp flower Example"
                default y

            config RTT_AI_EXAMPLES_SQ_HANDKP_OCR
                bool "Sq handkp ocr Example"
                default y

            config RTT_AI_EXAMPLES_SQ_HANDRECO
                bool "Sq handreco Example"
                default y

            config RTT_AI_EXAMPLES_TRAFFIC_LIGHT_DETECT
                bool "Traffic light detect Example"
                default y

            config RTT_AI_EXAMPLES_TRANSLATE_EN_CH
                bool "Translate en ch Example"
                default y

            config RTT_AI_EXAMPLES_TTS_ZH
                bool "Tts zh Example"
                default y

            config RTT_AI_EXAMPLES_VEHICLE_ATTR
                bool "Vehicle attr Example"
                default y

            config RTT_AI_EXAMPLES_VIRTUAL_KEYBOARD
                bool "Virtual keyboard Example"
                default y

            config RTT_AI_EXAMPLES_YOLOP_LANE_SEG
                bool "Yolop lane seg Example"
                default y

        endif

        menuconfig RTT_ENABLE_BUILD_KPU_RUN_EXAMPLES
            bool "Enable build kpu run yolov8 examples"
            default n

            if RTT_ENABLE_BUILD_KPU_RUN_EXAMPLES

                config RTT_KPU_RUN_YOLOV8_CAMERA
                    bool "Kpu run yolov8 camera"
                    default y

                config RTT_KPU_RUN_YOLOV8_IMAGE
                    bool "Kpu run yolov8 image"
                    default y

            endif

        menuconfig RTT_ENABLE_BUILD_AI2D_EXAMPLES
            bool "Enable build ai2d examples"
            default n

            if RTT_ENABLE_BUILD_AI2D_EXAMPLES

                config RTT_AI2D_CROP
                    bool "ai2d crop example"
                    default y

                config RTT_AI2D_PAD
                    bool "ai2d pad example"
                    default y

                config RTT_AI2D_RESIZE
                    bool "ai2d resize example"
                    default y

                config RTT_AI2D_AFFINE
                    bool "ai2d affine example"
                    default y

                config RTT_AI2D_SHIFT
                    bool "ai2d shift example"
                    default y

            endif

    endif
    
```

## src/uboot/Kconfig
```kconfig
menu "Uboot Configuration"

    config UBOOT_ENV_FILE
        string "Uboot enviroment file"
        default "default.env"

    config UBOOT_CONFIG_FILE
        string "Uboot config file prefix"
        default BOARD
        help
            uboot board config file name without _defconfig

    menuconfig UBOOT_ENABLE_FAST_BOOT
        bool "Uboot Enable FastBoot"

        if UBOOT_ENABLE_FAST_BOOT
            choice UBOOT_FAST_BOOT_TYPE
                bool "Uboot FastBoot Image Type"
                default UBOOT_FAST_BOOT_RTSMART

                config UBOOT_FAST_BOOT_RTSMART
                    bool "FastBoot RTSMART"
                config UBOOT_FAST_BOOT_LINUX
                    bool "FastBoot Linux"
            endchoice

            config UBOOT_SPL_BOOT_IMG_TYPE
                int
                default 0 if UBOOT_FAST_BOOT_LINUX
                default 1 if UBOOT_FAST_BOOT_RTSMART

        endif

endmenu
```
