## Kconfig.canmv
```kconfig
menuconfig SDK_ENABLE_CANMV
    bool "CanMV Components Configuration"
    default n

    if SDK_ENABLE_CANMV
        config ENABLE_NETWORK_RT_LAN
            bool "Enable Network RT-Thread Lan(eth)"
            default n
        config ENABLE_NETWORK_RT_WLAN
            bool "Enable Network RT-Thread Wlan"
            default y
    endif
```

## boards/Kconfig
```kconfig
menu "Board Configuration"
    choice BOARD
        bool "Board Type"
        default BOARD_K230_CANMV

        config BOARD_K230_CANMV
            bool "K230 CanMV, Onboard 512M"

        config BOARD_K230_CANMV_V3P0
            bool "K230 CanMV V3.0, Onboard 1GiB LPDDR4"

        config BOARD_K230_CANMV_LCKFB
            bool "K230 CanMV LCKFB, Onboard 1GiB LPDDR4"

        config BOARD_K230_CANMV_01STUDIO
            bool "K230 CanMV 01 Studio, Onboard 1GiB LPDDR4"

        config BOARD_K230D_CANMV_BPI_ZERO
            bool "K230D CanMV BPI-Zero, SiP 128MiB LPDDR4"

        config BOARD_K230_CANMV_DONGSHANPI
            bool "K230 CanMV dongshanpi, Onboard 512MiB/1GiB LPDDR3"

        config BOARD_K230_AIHARDWARE
            bool "K230 AiHardWare, Onboard 512M LPDDR4"

    endchoice

    config BOARD
        string
        default "k230_canmv" if BOARD_K230_CANMV
        default "k230_canmv_v3p0" if BOARD_K230_CANMV_V3P0
        default "k230_canmv_lckfb" if BOARD_K230_CANMV_LCKFB
        default "k230_canmv_01studio" if BOARD_K230_CANMV_01STUDIO
        default "k230d_canmv_bpi_zero" if BOARD_K230D_CANMV_BPI_ZERO
	    default "k230_canmv_dongshanpi" if BOARD_K230_CANMV_DONGSHANPI
	    default "k230_aihardware" if BOARD_K230_AIHARDWARE

    config BOARD_NAME
        string "Board Generate Image Name"
        default "CanMV-K230" if BOARD_K230_CANMV
        default "CanMV-K230-V3P0" if BOARD_K230_CANMV_V3P0
        default "CanMV-K230_LCKFB" if BOARD_K230_CANMV_LCKFB
        default "CanMV-K230_01Studio" if BOARD_K230_CANMV_01STUDIO
        default "CanMV-K230D_Zero" if BOARD_K230D_CANMV_BPI_ZERO
        default "K230_AiHardWare" if BOARD_K230_AIHARDWARE

    config BOARD_GEN_IMAGE_CFG_FILE
        string "Board specified generate image configure file"
        default "genimage-sdcard.cfg"

    menu "Memory Layout"
        config AUTO_DETECT_DDR_SIZE
            bool "Auto Detect DRAM Size"
                default y  if BOARD_K230_CANMV_01STUDIO ||  BOARD_K230_CANMV_DONGSHANPI
                default n

        source "$(SDK_BOARDS_DIR)/Kconfig.memory_auto"
        source "$(SDK_BOARDS_DIR)/Kconfig.memory_static"
    endmenu

    config MEM_BASE_ADDR
        hex
        default MEM_RTSMART_BASE

    config MEM_RTSMART_BASE
        hex
        default 0x0000000
        help
            Should same as uboot dts memory node

    config RTSMART_OPENSIB_MEMORY_SIZE
        hex
        default 0x20000

    source "$(SDK_BOARD_DIR)/Kconfig"

endmenu
```

## boards/Kconfig.memory_auto
```kconfig
if AUTO_DETECT_DDR_SIZE
    menuconfig AUTO_DDR_SIZE_512
        bool "Memory Layout for 512M DDR"
        default y

        if  AUTO_DDR_SIZE_512
            config MEM_RTSMART_HEAP_SIZE_512
                hex "512M ddr RT-Smart Memory Heap Size"
                default 0x02000000

            config MEM_RTSMART_SIZE_512
                hex "512M ddr RT-Smart Memory Size"
                default 0x10000000

            config MEM_MMZ_BASE_512
                hex "512M ddr Memory address of MMZ"
                default 0x10000000

            config MEM_MMZ_SIZE_512
                hex "512M ddr Memory size for MMZ"
                default 0x10000000
        endif

    menuconfig AUTO_DDR_SIZE_1024
        bool "Memory Layout for 1024M DDR"
        default y

        if  AUTO_DDR_SIZE_1024
            config MEM_RTSMART_HEAP_SIZE_1024
                hex "1024M ddr RT-Smart Memory Heap Size"
                default 0x04000000

            config MEM_RTSMART_SIZE_1024
                hex "1024M ddr RT-Smart Memory Size"
                default 0x20000000

            config MEM_MMZ_BASE_1024
                hex "1024M ddr Memory address of MMZ"
                default 0x20000000

            config MEM_MMZ_SIZE_1024
                hex "1024M ddr Memory size for MMZ"
                default 0x20000000
        endif

    menuconfig AUTO_DDR_SIZE_2048
        bool "Memory Layout for 2048M DDR"
        default y

        if  AUTO_DDR_SIZE_2048
            config MEM_RTSMART_HEAP_SIZE_2048
                hex "2048M ddr RT-Smart Memory Heap Size"
                default 0x04000000

            config MEM_RTSMART_SIZE_2048
                hex "2048M ddr RT-Smart Memory Total Size"
                default 0x20000000

            config MEM_MMZ_BASE_2048
                hex "2048M ddr Memory address of MMZ"
                default 0x20000000

            config MEM_MMZ_SIZE_2048
                hex "2048M ddr Memory size for MMZ"
                default 0x60000000
        endif
endif
```

## boards/Kconfig.memory_static
```kconfig
if !AUTO_DETECT_DDR_SIZE
    config MEM_TOTAL_SIZE
        hex "DDR Memory Size"
        default 0x20000000 if BOARD_K230_CANMV
        default 0x40000000 if BOARD_K230_CANMV_V3P0
        default 0x40000000 if BOARD_K230_CANMV_LCKFB
        default 0x40000000 if BOARD_K230_CANMV_01STUDIO
        default 0x8000000 if BOARD_K230D_CANMV_BPI_ZERO
        default 0x20000000 if BOARD_K230_CANMV_DONGSHANPI
        default 0x20000000 if BOARD_K230_AIHARDWARE
        help
            Should same as uboot dts memory node

    comment "Memory Layout"

    config MEM_RTSMART_SIZE
        hex "RT-Smart Memory Total Size"
        default 0x10000000 if BOARD_K230_CANMV
        default 0x20000000 if BOARD_K230_CANMV_V3P0
        default 0x20000000 if BOARD_K230_CANMV_LCKFB
        default 0x20000000 if BOARD_K230_CANMV_01STUDIO
        default 0x3000000 if BOARD_K230D_CANMV_BPI_ZERO
        default 0x10000000 if BOARD_K230_CANMV_DONGSHANPI
        default 0x10000000 if BOARD_K230_AIHARDWARE

    config MEM_RTSMART_HEAP_SIZE
        hex "RT-Smart Memory Heap Size"
        default 0x2000000 if BOARD_K230_CANMV
        default 0x4000000 if BOARD_K230_CANMV_V3P0
        default 0x4000000 if BOARD_K230_CANMV_LCKFB
        default 0x4000000 if BOARD_K230_CANMV_01STUDIO
        default 0xA00000 if BOARD_K230D_CANMV_BPI_ZERO
        default 0x2000000 if BOARD_K230_CANMV_DONGSHANPI
        default 0x2000000 if BOARD_K230_AIHARDWARE

    config MEM_MMZ_BASE
        hex "Memory address of MMZ"
        default 0x10000000 if BOARD_K230_CANMV
        default 0x20000000 if BOARD_K230_CANMV_V3P0
        default 0x20000000 if BOARD_K230_CANMV_LCKFB
        default 0x20000000 if BOARD_K230_CANMV_01STUDIO
        default 0x3000000 if BOARD_K230D_CANMV_BPI_ZERO
        default 0x10000000 if BOARD_K230_CANMV_DONGSHANPI
        default 0x10000000 if BOARD_K230_AIHARDWARE

    config MEM_MMZ_SIZE
        hex "Memory size for mmz"
        default 0x10000000 if BOARD_K230_CANMV
        default 0x20000000 if BOARD_K230_CANMV_V3P0
        default 0x20000000 if BOARD_K230_CANMV_LCKFB
        default 0x20000000 if BOARD_K230_CANMV_01STUDIO
        default 0x5000000 if BOARD_K230D_CANMV_BPI_ZERO
        default 0x10000000 if BOARD_K230_CANMV_DONGSHANPI
        default 0x10000000 if BOARD_K230_AIHARDWARE
endif
```

## boards/k230_canmv/Kconfig
```kconfig
if BOARD_K230_CANMV
    config BOARD_NOT_SUPPORT_HW_RTC
        def_bool y
endif
```

## boards/k230_canmv_01studio/Kconfig
```kconfig
if BOARD_K230_CANMV_01STUDIO
    config BOARD_NOT_SUPPORT_HW_RTC
        def_bool y
endif
```

## boards/k230d_canmv_atk_dnk230d/Kconfig
```kconfig
if BOARD_K230D_CANMV_ATK_DNK230D
    config BOARD_NOT_SUPPORT_HW_RTC
        def_bool y
endif
```

## configs/k230_aihardware__128m_defconfig
```kconfig
CONFIG_BOARD_K230_AIHARDWARE=y
CONFIG_MEM_TOTAL_SIZE=0x8000000
CONFIG_MEM_RTSMART_SIZE=0x4000000
CONFIG_MEM_RTSMART_HEAP_SIZE=0x400000
CONFIG_MEM_MMZ_BASE=0x4000000
CONFIG_MEM_MMZ_SIZE=0x4000000
# CONFIG_RT_AUTO_RESIZE_PARTITION is not set
CONFIG_MPP_ENABLE_CSI_DEV_0=y
CONFIG_MPP_ENABLE_CSI_DEV_1=y
CONFIG_MPP_ENABLE_CSI_DEV_2=y
```

## configs/k230_aihardware_defconfig
```kconfig
CONFIG_BOARD_K230_AIHARDWARE=y
# CONFIG_RT_AUTO_RESIZE_PARTITION is not set
CONFIG_MPP_ENABLE_CSI_DEV_0=y
CONFIG_MPP_ENABLE_CSI_DEV_1=y
CONFIG_MPP_ENABLE_CSI_DEV_2=y
```

## configs/k230_canmv_01studio_defconfig
```kconfig
CONFIG_BOARD_CONFIG_NAME="k230_canmv_01studio_defconfig"
CONFIG_BOARD_K230_CANMV_01STUDIO=y
CONFIG_ENABLE_UVC_CAMERA=y
CONFIG_MPP_DEFAULT_SENSOR_CSI_2=y
CONFIG_MPP_ENABLE_CSI_DEV_0=y
CONFIG_MPP_CSI_DEV0_RESET=10
CONFIG_MPP_ENABLE_CSI_DEV_1=y
CONFIG_MPP_CSI_DEV1_RESET=45
CONFIG_MPP_ENABLE_CSI_DEV_2=y
CONFIG_MPP_CSI_DEV2_RESET=62
CONFIG_MPP_CSI_DEV2_I2C_DEV="i2c4"
CONFIG_MPP_CSI_DEV2_MCLK_3=y
CONFIG_MPP_ENABLE_SENSOR_GC2093=y
CONFIG_MPP_SENSOR_GC2093_ON_CSI2_USE_CHIP_CLK=y
CONFIG_MPP_ENABLE_SENSOR_OV5647=y
CONFIG_MPP_SENSOR_OV5647_ON_CSI2_USE_CHIP_CLK=y
CONFIG_MPP_ENABLE_SENSOR_IMX335=y
CONFIG_MPP_SENSOR_IMX335_ON_CSI2_USE_CHIP_CLK=y
CONFIG_MPP_ENABLE_SENSOR_SC132GS=y
CONFIG_MPP_ENABLE_SENSOR_SC132GS_ON_CSI2_USE_CHIP_CLK=y
CONFIG_MPP_ENABLE_SENSOR_BF3238=y
CONFIG_MPP_ENABLE_SENSOR_BF3238_ON_CSI2_USE_CHIP_CLK=y
CONFIG_MPP_ENABLE_DSI_HDMI=y
CONFIG_MPP_ENABLE_DSI_LCD=y
CONFIG_MPP_DSI_ENABLE_HDMI_LT9611=y
CONFIG_MPP_DSI_ENABLE_LCD_HX8399=y
CONFIG_MPP_DSI_ENABLE_LCD_ST7701=y
CONFIG_SDK_ENABLE_CANMV=y
CONFIG_CANMV_OPENMV_CFG_FB_ALLOC_SIZE=0x1400000
CONFIG_CANMV_OPENMV_CFG_FB_ALLOC_COUNT=640
```

## configs/k230_canmv_defconfig
```kconfig
CONFIG_MPP_ENABLE_CSI_DEV_0=y
CONFIG_MPP_CSI_DEV0_RESET=0
CONFIG_MPP_CSI_DEV0_I2C_DEV="i2c3"
CONFIG_MPP_CSI_DEV0_MCLK_1=y
CONFIG_MPP_ENABLE_CSI_DEV_1=y
CONFIG_MPP_CSI_DEV1_RESET=23
CONFIG_MPP_CSI_DEV1_I2C_DEV="i2c0"
CONFIG_MPP_ENABLE_CSI_DEV_2=y
CONFIG_MPP_CSI_DEV2_RESET=24
CONFIG_MPP_CSI_DEV2_I2C_DEV="i2c1"
CONFIG_MPP_ENABLE_SENSOR_GC2093=y
CONFIG_MPP_SENSOR_GC2093_ON_CSI0_USE_CHIP_CLK=y
CONFIG_MPP_ENABLE_SENSOR_OV5647=y
CONFIG_MPP_SENSOR_OV5647_ON_CSI0_USE_CHIP_CLK=y
CONFIG_MPP_ENABLE_DSI_HDMI=y
CONFIG_MPP_DSI_HDMI_RESET_PIN=42
CONFIG_MPP_DSI_HDMI_I2C_DEV="i2c4"
CONFIG_MPP_ENABLE_DSI_LCD=y
CONFIG_MPP_DSI_LCD_RESET_PIN=20
CONFIG_MPP_DSI_ENABLE_HDMI_LT9611=y
CONFIG_MPP_DSI_ENABLE_HDMI_HX8399=y
CONFIG_MPP_DSI_ENABLE_LCD_ST7701=y
CONFIG_SDK_ENABLE_CANMV=y
CONFIG_ENABLE_NETWORK_RT_LAN=y
```

## configs/k230_canmv_dongshanpi_defconfig
```kconfig
CONFIG_BOARD_K230_CANMV_DONGSHANPI=y
CONFIG_BOARD_CONFIG_NAME="k230_canmv_dongshanpi_defconfig"
CONFIG_BOARD_NAME="CanMV-K230_DONGSHANPI"
CONFIG_UBOOT_USE_CUSTOM_CONFIG_FILE=y
CONFIG_UBOOT_CUSTOM_CONFIG_FILE="k230_canmv_dongshanpi_defconfig"
CONFIG_MPP_ENABLE_CSI_DEV_0=y
CONFIG_MPP_CSI_DEV0_POWER=9
CONFIG_MPP_CSI_DEV0_RESET=10
CONFIG_MPP_ENABLE_CSI_DEV_1=y
CONFIG_MPP_CSI_DEV1_POWER=11
CONFIG_MPP_CSI_DEV1_RESET=12
CONFIG_MPP_ENABLE_CSI_DEV_2=y
CONFIG_MPP_CSI_DEV2_RESET=21
CONFIG_MPP_CSI_DEV2_I2C_DEV="i2c4"
CONFIG_MPP_CSI_DEV2_MCLK_1=y
CONFIG_MPP_ENABLE_SENSOR_GC2093=y
CONFIG_MPP_SENSOR_GC2093_ON_CSI2_USE_CHIP_CLK=y
CONFIG_MPP_ENABLE_SENSOR_OV5647=y
CONFIG_MPP_SENSOR_OV5647_ON_CSI2_USE_CHIP_CLK=y
CONFIG_MPP_ENABLE_DSI_LCD=y
CONFIG_MPP_DSI_LCD_RESET_PIN=22
CONFIG_MPP_DSI_ENABLE_LCD_ST7701=y
CONFIG_MPP_DSI_ENABLE_LCD_ILI9806=y
CONFIG_SDK_ENABLE_CANMV=y
CONFIG_MPP_DEFAULT_SENSOR_CSI_2=y
CONFIG_CANMV_OPENMV_CFG_FB_ALLOC_SIZE=0x1400000
CONFIG_CANMV_OPENMV_CFG_FB_ALLOC_COUNT=640
```

## configs/k230_canmv_labplus_1956_defconfig
```kconfig
CONFIG_BOARD_CONFIG_NAME="k230_canmv_labplus_1956_defconfig"
CONFIG_BOARD_K230_LABPLUS_1956=y
CONFIG_AUTO_DETECT_DDR_SIZE=y
# CONFIG_AUTO_DDR_SIZE_512 is not set
# CONFIG_AUTO_DDR_SIZE_2048 is not set
CONFIG_MPP_DEFAULT_SENSOR_CSI_2=y
CONFIG_MPP_ENABLE_CSI_DEV_2=y
CONFIG_MPP_CSI_DEV2_RESET=14
CONFIG_MPP_CSI_DEV2_I2C_DEV="i2c4"
CONFIG_MPP_CSI_DEV2_MCLK_1=y
CONFIG_MPP_ENABLE_SENSOR_GC2093=y
CONFIG_MPP_SENSOR_GC2093_ON_CSI2_USE_CHIP_CLK=y
CONFIG_MPP_ENABLE_SENSOR_BF3238=y
CONFIG_MPP_ENABLE_SENSOR_BF3238_ON_CSI2_USE_CHIP_CLK=y
CONFIG_MPP_ENABLE_DSI_LCD=y
CONFIG_MPP_DSI_LCD_RESET_PIN=22
CONFIG_MPP_DSI_ENABLE_LCD_ST7701=y
CONFIG_SDK_ENABLE_CANMV=y
# CONFIG_ENABLE_TOUCH_DRIVER_CST_MUTCAP is not set
# CONFIG_ENABLE_TOUCH_DRIVER_GT911 is not set
```

## configs/k230_canmv_lckfb_defconfig
```kconfig
CONFIG_BOARD_K230_CANMV_LCKFB=y
CONFIG_MPP_ENABLE_CSI_DEV_0=y
CONFIG_MPP_CSI_DEV0_POWER=9
CONFIG_MPP_CSI_DEV0_RESET=29
CONFIG_MPP_ENABLE_CSI_DEV_1=y
CONFIG_MPP_CSI_DEV1_POWER=30
CONFIG_MPP_CSI_DEV1_RESET=31
CONFIG_MPP_ENABLE_CSI_DEV_2=y
CONFIG_MPP_CSI_DEV2_POWER=21
CONFIG_MPP_CSI_DEV2_RESET=13
CONFIG_MPP_CSI_DEV2_I2C_DEV="i2c4"
CONFIG_MPP_ENABLE_SENSOR_GC2093=y
CONFIG_MPP_ENABLE_DSI_LCD=y
CONFIG_MPP_DSI_LCD_RESET_PIN=22
CONFIG_MPP_DSI_ENABLE_LCD_ST7701=y
CONFIG_SDK_ENABLE_CANMV=y
CONFIG_ENABLE_NETWORK_RT_LAN=y
```

## configs/k230_canmv_v3p0_defconfig
```kconfig
CONFIG_BOARD_CONFIG_NAME="k230_canmv_v3p0_defconfig"
CONFIG_BOARD_K230_CANMV_V3P0=y
CONFIG_MPP_DEFAULT_SENSOR_CSI_2=y
CONFIG_MPP_ENABLE_CSI_DEV_0=y
CONFIG_MPP_CSI_DEV0_RESET=10
CONFIG_MPP_ENABLE_CSI_DEV_1=y
CONFIG_MPP_CSI_DEV1_RESET=12
CONFIG_MPP_ENABLE_CSI_DEV_2=y
CONFIG_MPP_CSI_DEV2_RESET=21
CONFIG_MPP_CSI_DEV2_I2C_DEV="i2c4"
CONFIG_MPP_CSI_DEV2_MCLK_1=y
CONFIG_MPP_ENABLE_SENSOR_GC2093=y
CONFIG_MPP_SENSOR_GC2093_ON_CSI2_USE_CHIP_CLK=y
CONFIG_MPP_ENABLE_SENSOR_OV5647=y
CONFIG_MPP_SENSOR_OV5647_ON_CSI2_USE_CHIP_CLK=y
CONFIG_MPP_ENABLE_SENSOR_BF3238=y
CONFIG_MPP_ENABLE_SENSOR_BF3238_ON_CSI2_USE_CHIP_CLK=y
CONFIG_MPP_ENABLE_DSI_HDMI=y
CONFIG_MPP_DSI_HDMI_RESET_PIN=24
CONFIG_MPP_ENABLE_DSI_LCD=y
CONFIG_MPP_DSI_LCD_RESET_PIN=22
CONFIG_MPP_DSI_ENABLE_HDMI_LT9611=y
CONFIG_MPP_DSI_ENABLE_LCD_HX8399=y
CONFIG_MPP_DSI_ENABLE_LCD_ST7701=y
CONFIG_SDK_ENABLE_CANMV=y
```

## configs/k230_evb__k230d_defconfig
```kconfig
CONFIG_BOARD_K230_EVB=y
CONFIG_BOARD_NAME="K230D-EVB"
CONFIG_BOARD_CONFIG_FILE="k230_evb__k230d"
CONFIG_AUTO_DETECT_DDR_SIZE=y
# CONFIG_AUTO_DDR_SIZE_1024 is not set
# CONFIG_AUTO_DDR_SIZE_2048 is not set
CONFIG_UBOOT_CONFIG_FILE="k230d_evb"
CONFIG_RTT_AUTO_EXEC_CMD=""
CONFIG_MPP_ENABLE_CSI_DEV_0=y
CONFIG_MPP_CSI_DEV0_RESET=46
CONFIG_MPP_ENABLE_SENSOR_IMX335=y
CONFIG_MPP_SENSOR_IMX335_ENABLE_4LANE_CONFIGURE=y
CONFIG_MPP_ENABLE_DSI_LCD=y
CONFIG_MPP_DSI_LCD_RESET_PIN=9
CONFIG_MPP_DSI_LCD_BACKLIGHT_PIN=31
# CONFIG_MPP_DSI_ENABLE_VIRT is not set
CONFIG_MPP_DSI_ENABLE_HDMI_HX8399=y
```

## configs/k230_evb_defconfig
```kconfig
CONFIG_BOARD_K230_EVB=y
CONFIG_AUTO_DETECT_DDR_SIZE=y
# CONFIG_AUTO_DDR_SIZE_1024 is not set
# CONFIG_AUTO_DDR_SIZE_2048 is not set
CONFIG_RTT_AUTO_EXEC_CMD=""
# CONFIG_MPP_DSI_ENABLE_VIRT is not set
```

## configs/k230_rtos_01studio_defconfig
```kconfig
CONFIG_BOARD_CONFIG_NAME="k230_rtos_01studio_defconfig"
CONFIG_BOARD_K230_CANMV_01STUDIO=y
CONFIG_BOARD_NAME="RtSmart-K230_01Studio"
CONFIG_BOARD_GEN_IMAGE_CFG_FILE="genimage-sdcard-rtos.cfg"
CONFIG_RTT_AUTO_EXEC_CMD="/sdcard/app/integrated_poc/smart_ipc.elf -K /sdcard/app/integrated_poc/face_detection_320.kmodel -C 1"
CONFIG_RTT_ENABLE_BUILD_EXAMPLES=y
CONFIG_RTT_ENABLE_BUILD_INTEGRATED_EXAMPLES=y
CONFIG_MPP_DEFAULT_SENSOR_CSI_2=y
CONFIG_MPP_ENABLE_CSI_DEV_0=y
CONFIG_MPP_CSI_DEV0_RESET=10
CONFIG_MPP_ENABLE_CSI_DEV_1=y
CONFIG_MPP_CSI_DEV1_RESET=45
CONFIG_MPP_ENABLE_CSI_DEV_2=y
CONFIG_MPP_CSI_DEV2_RESET=62
CONFIG_MPP_CSI_DEV2_I2C_DEV="i2c4"
CONFIG_MPP_CSI_DEV2_MCLK_3=y
CONFIG_MPP_ENABLE_SENSOR_GC2093=y
CONFIG_MPP_SENSOR_GC2093_ON_CSI2_USE_CHIP_CLK=y
CONFIG_MPP_ENABLE_SENSOR_OV5647=y
CONFIG_MPP_SENSOR_OV5647_ON_CSI2_USE_CHIP_CLK=y
CONFIG_MPP_ENABLE_SENSOR_IMX335=y
CONFIG_MPP_SENSOR_IMX335_ON_CSI2_USE_CHIP_CLK=y
CONFIG_MPP_ENABLE_SENSOR_SC132GS=y
CONFIG_MPP_ENABLE_SENSOR_SC132GS_ON_CSI2_USE_CHIP_CLK=y
CONFIG_MPP_ENABLE_SENSOR_BF3238=y
CONFIG_MPP_ENABLE_SENSOR_BF3238_ON_CSI2_USE_CHIP_CLK=y
CONFIG_MPP_ENABLE_DSI_HDMI=y
CONFIG_MPP_ENABLE_DSI_LCD=y
CONFIG_MPP_DSI_ENABLE_HDMI_LT9611=y
CONFIG_MPP_DSI_ENABLE_LCD_HX8399=y
CONFIG_MPP_DSI_ENABLE_LCD_ST7701=y
```
