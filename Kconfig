## Kconfig
```kconfig
menuconfig SDK_ENABLE_CANMV
    bool "CanMV Micropython Components Configuration"
    default n

    if SDK_ENABLE_CANMV
        
        source "$(SDK_CANMV_SRC_DIR)/Kconfig.micropython"
        source "$(SDK_CANMV_SRC_DIR)/k230/Kconfig"

    endif
```

## Kconfig.micropython
```kconfig
menu "CanMV Micropython Components Configurations"
    comment "IDE/REPL UART Configuration"

    choice
        bool "IDE Debug UART"
        default CANMV_REPL_UART_USB

        config CANMV_REPL_UART_USB
            bool "USB CDC (/dev/ttyGS0)"

        config CANMV_REPL_UART_0
            bool "UART 0"

        config CANMV_REPL_UART_1
            bool "UART 1"

        config CANMV_REPL_UART_2
            bool "UART 2"

        config CANMV_REPL_UART_3
            bool "UART 3"

        config CANMV_REPL_UART_4
            bool "UART 4"

    endchoice

    config CANMV_REPL_UART_ID
        int
        default -1 if CANMV_REPL_UART_USB
        default 0  if CANMV_REPL_UART_0
        default 1  if CANMV_REPL_UART_1
        default 2  if CANMV_REPL_UART_2
        default 3  if CANMV_REPL_UART_3
        default 4  if CANMV_REPL_UART_4

    config ENABLE_MODULE_CV_LITE
        bool "Enable CV_Lite Module"
        default y

    config ENABLE_MODULE_OPEN_KWS
        bool "Enable open-vocabulary KWS (open_kws) module"
        default y
        help
          Build the open_kws module (custom wake words enrolled on device)
          and copy the 31-OPEN-KWS example to the SD card image.

    config ENABLE_MODULE_UART_PERIODIC_TX
        bool "Enable UART periodic TX module"
        default n
        help
          Build the uart_periodic_tx module, which transmits complete UART
          frames from a hardware timer without executing Python in the timer
          callback.

    config ENABLE_MODULE_WEBRTC
        bool "Enable WebRTC module"
        default y
        select RTSMART_3RD_PARTY_ENABLE_LIBPEER
        help
          Build the native MicroPython WebRTC peer connection module.

    config ENABLE_MODULE_RTSP_PUSHER
        bool "Enable RTSP pusher module"
        default n
        select MPP_ENABLE_MIDDLEWARE_LIB_RTSP_PUSHER
        help
          Build the MicroPython RTSP pusher module and its middleware
          dependency.

    config ENABLE_BLUETOOTH
        bool "Enable Bluetooth module (NimBLE over RT-Smart HCI)"
        default n
        help
          Build MicroPython's bluetooth module with the NimBLE host stack.
          The RT-Smart image must expose at least one Bluetooth H:4
          controller. CanMV selects the first available /dev/hciX device.

endmenu
```

## k230/Kconfig
```kconfig
choice 
    bool "Micropython Repl Over"
    default CANMV_MPY_REPL_OVER_USB_CDC

    config CANMV_MPY_REPL_OVER_STDIN
        bool "STDIN"
    config CANMV_MPY_REPL_OVER_USB_CDC
        bool "USB CDC"
    config CANMV_MPY_REPL_OVER_UART
        bool "UART"
endchoice

if CANMV_MPY_REPL_OVER_UART
    choice 
        bool "Micropython Repl Over UART"
        default CANMV_MPY_REPL_OVER_UART3

        config CANMV_MPY_REPL_OVER_UART1
            bool "1"
        config CANMV_MPY_REPL_OVER_UART2
            bool "2"
        config CANMV_MPY_REPL_OVER_UART3
            bool "3"
        config CANMV_MPY_REPL_OVER_UART4
            bool "4"
    endchoice

    config CANMV_MPY_REPL_OVER_UART_NUM
        int
        default 1 if CANMV_MPY_REPL_OVER_UART1
        default 2 if CANMV_MPY_REPL_OVER_UART2
        default 3 if CANMV_MPY_REPL_OVER_UART3
        default 4 if CANMV_MPY_REPL_OVER_UART4
endif
```
